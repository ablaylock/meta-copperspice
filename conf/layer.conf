## conf/layer.conf
```bitbake
BBPATH .= ":${LAYERDIR}"

BBFILES += "${LAYERDIR}/recipes-*/*/*.bb \
            ${LAYERDIR}/recipes-*/*/*.bbappend"

BBFILE_COLLECTIONS += "copperspice"
BBFILE_PATTERN_copperspice = "^${LAYERDIR}/"
BBFILE_PRIORITY_copperspice = "6"

LAYERDEPENDS_copperspice = "core"
LAYERSERIES_COMPAT_copperspice = "wrynose"
```
